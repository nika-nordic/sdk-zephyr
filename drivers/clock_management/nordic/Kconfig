## drivers/clock_management/nordic/Kconfig
```kconfig
# Copyright (c) 2026 Nordic Semiconductor ASA
# SPDX-License-Identifier: Apache-2.0

config CLOCK_MANAGEMENT_NORDIC
	bool "Nordic clock management drivers"
	default y
	depends on DT_HAS_NORDIC_NRF5340_HFXO_ENABLED || \
		   DT_HAS_NORDIC_NRF5340_HFINT_ENABLED || \
		   DT_HAS_NORDIC_NRF5340_HFCLK_ENABLED
	help
	  Enable clock management node drivers for Nordic nRF5340 clock tree
	  (HFXO / HFINT root clocks and the HFCLK source multiplexer). These
	  drivers showcase the clock-states concept on nRF5340.
```

## dts/bindings/clock/nordic,nrf5340-hfclk.yaml
```yaml
# Copyright (c) 2026 Nordic Semiconductor ASA
# SPDX-License-Identifier: Apache-2.0

description: |
  nRF5340 HFCLK source multiplexer as a clock-management mux node. The HFCLK
  domain is driven either by the internal RC oscillator (HFINT) or the crystal
  oscillator (HFXO). Selecting HFXO causes the driver to start the crystal;
  selecting HFINT stops it. Accepts one specifier: the zero-based index into
  the "input-sources" phandle array.

compatible: "nordic,nrf5340-hfclk"

include: [clock-node.yaml]

properties:
  input-sources:
    type: phandles
    required: true
    description: |
      Input sources to the HFCLK multiplexer. Index 0 must be the internal RC
      oscillator (HFINT), index 1 the crystal oscillator (HFXO).

  "#clock-cells":
    const: 1

clock-cells:
  - source
```

## dts/bindings/clock/nordic,nrf5340-hfint.yaml
```yaml
# Copyright (c) 2026 Nordic Semiconductor ASA
# SPDX-License-Identifier: Apache-2.0

description: |
  nRF5340 internal high-frequency RC oscillator (HFINT) as a clock-management
  root clock node. HFINT is always available and is the default source for the
  HFCLK domain. Modelled as a root clock that reports the peripheral-visible
  frequency (PCLK) it produces.

compatible: "nordic,nrf5340-hfint"

include: [clock-node.yaml]

properties:
  clock-frequency:
    type: int
    required: true
    description: Peripheral clock frequency produced by this source, in Hz

  "#clock-cells":
    const: 0
```

## dts/bindings/clock/nordic,nrf5340-hfxo.yaml
```yaml
# Copyright (c) 2026 Nordic Semiconductor ASA
# SPDX-License-Identifier: Apache-2.0

description: |
  nRF5340 high-frequency crystal oscillator (HFXO) as a clock-management root
  clock node. HFXO provides a crystal-accurate source for the HFCLK domain and
  must be started explicitly. Modelled as a root clock that reports the
  peripheral-visible frequency (PCLK) it produces. Starting/stopping of the
  crystal is performed by the HFCLK multiplexer when it selects this source.

compatible: "nordic,nrf5340-hfxo"

include: [clock-node.yaml]

properties:
  clock-frequency:
    type: int
    required: true
    description: Peripheral clock frequency produced by this source, in Hz

  "#clock-cells":
    const: 0
```

## samples/spi_profiling/boards/nrf52840dk_nrf52840.conf
```kconfig
CONFIG_SPI=y
CONFIG_COUNTER=n
CONFIG_ASSERT=n
CONFIG_PM_DEVICE=n
CONFIG_PM_DEVICE_RUNTIME=n
```

## samples/spi_profiling/boards/nrf54h20dk_nrf54h20_cpuapp.conf
```kconfig
CONFIG_SPI=y
CONFIG_COUNTER=n
CONFIG_ASSERT=n
CONFIG_PM_DEVICE=y
CONFIG_PM_DEVICE_RUNTIME=y
```
